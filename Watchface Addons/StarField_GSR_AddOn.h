/* READ THIS PLEASE
 *
 *  The main Watchy face was imported from https://github.com/Prokuon/watchy-starfield
 *
 *  The libraries used are:
 *
 *  https://github.com/CelliesProjects/moonPhase-esp32
 *
 *  https://github.com/dmkishi/Dusk2Dawn
 *
 *  Please visit these libraries and like them, along with the original Starfield repo.
 *
 *  Some editing and cleanup of the Watch face and removal of non-imported library functions
 *  have been removed for space constraints.  Thanks to everyone who worked on this, I hope
 *  I was able to make this work properly in the Watchy GSR environment.
 */

#include <math.h>
#define SEVEN_SEGMENT10PT7B
#define DSEG7_CLASSIC_BOLD_53
#include "WatchyClassicFonts.h"

// Function Declarations here:  If you have any custom functions you wish to use in this file, you must declare them here:
/*
  MoonPhase - Library to get moon phase angle
  and percentage illuminated. (as seen from Earth)
  Created by Marcel Timmer, April 28, 2018.
  Code adapted from http://www.voidware.com/phase.c
  A big thanks to Hugh at voidware for granting permission.
  Released under MIT license.
*/

struct moonData_t
{
  int32_t angle;
  double  percentLit;
};

// Place all of your data here.  All Fonts and Image Data goes below this line and before the Variables.
// 'wifi', 25x18px
const unsigned char sfWiFiOn [] PROGMEM = {
	0x00, 0x7f, 0x00, 0x00, 0x03, 0xff, 0xe0, 0x00, 0x0f, 0xff, 0xf8, 0x00, 0x1f, 0xc1, 0xfc, 0x00, 
	0x7e, 0x00, 0x3f, 0x00, 0xf8, 0x3e, 0x0f, 0x80, 0x71, 0xff, 0xc7, 0x00, 0x23, 0xff, 0xe2, 0x00, 
	0x07, 0xc1, 0xf0, 0x00, 0x0f, 0x00, 0x78, 0x00, 0x06, 0x3e, 0x30, 0x00, 0x02, 0x7f, 0x20, 0x00, 
	0x00, 0xff, 0x80, 0x00, 0x00, 0xe3, 0x80, 0x00, 0x00, 0x49, 0x00, 0x00, 0x00, 0x1c, 0x00, 0x00, 
	0x00, 0x1c, 0x00, 0x00, 0x00, 0x08, 0x00, 0x00
};
// 'wifioff', 25x18px
const unsigned char sfWiFiOff [] PROGMEM = {
	0x00, 0x7f, 0x07, 0x80, 0x03, 0xff, 0xef, 0x00, 0x0f, 0xff, 0xfe, 0x00, 0x1f, 0xc1, 0xfc, 0x00, 
	0x7e, 0x00, 0xff, 0x00, 0xf8, 0x3f, 0xef, 0x80, 0x71, 0xff, 0xc7, 0x00, 0x23, 0xff, 0xe2, 0x00, 
	0x07, 0xdf, 0xf0, 0x00, 0x0f, 0x3e, 0x78, 0x00, 0x06, 0x7c, 0x30, 0x00, 0x02, 0xff, 0x20, 0x00, 
	0x01, 0xff, 0x80, 0x00, 0x03, 0xe3, 0x80, 0x00, 0x07, 0x49, 0x00, 0x00, 0x0e, 0x1c, 0x00, 0x00, 
	0x1c, 0x1c, 0x00, 0x00, 0x38, 0x08, 0x00, 0x00
};

const unsigned char sffield [] PROGMEM = {
	0x00, 0x00, 0x00, 0x00, 0x00, 0x00, 0x00, 0x00, 0x00, 0x00, 0x00, 0x00, 0x00, 0x00, 0x00, 0x00, 
	0x00, 0x00, 0x00, 0x00, 0x00, 0x00, 0x00, 0x00, 0x00, 0x01, 0xff, 0xc0, 0x00, 0x00, 0x00, 0x00, 
	0x00, 0x00, 0x00, 0x00, 0x00, 0x00, 0x00, 0x00, 0x00, 0x00, 0x00, 0x00, 0x00, 0x00, 0x00, 0x07, 
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	0x00, 0x00, 0x00, 0x00, 0x00, 0x00, 0x00, 0x00
};

// 'sfluna1', 61x61px
const unsigned char sfluna1 [] PROGMEM = {
	0x00, 0x00, 0x00, 0x3f, 0xe0, 0x00, 0x00, 0x00, 0x00, 0x00, 0x03, 0xc1, 0x1e, 0x00, 0x00, 0x00, 
	0x00, 0x00, 0x1e, 0x02, 0x01, 0xc0, 0x00, 0x00, 0x00, 0x00, 0x61, 0xfc, 0x01, 0x30, 0x00, 0x00, 
	0x00, 0x01, 0x80, 0x00, 0x02, 0x0c, 0x00, 0x00, 0x00, 0x06, 0xc0, 0x00, 0x0c, 0x03, 0x00, 0x00, 
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	0x00, 0x00, 0x00, 0x3f, 0xe0, 0x00, 0x00, 0x00
};


// 'sfluna2', 61x61px
const unsigned char sfluna2 [] PROGMEM = {
	0x00, 0x00, 0x00, 0x3f, 0xf0, 0x00, 0x00, 0x00, 0x00, 0x00, 0x03, 0xfe, 0xff, 0x00, 0x00, 0x00, 
	0x00, 0x00, 0x1d, 0xfd, 0xff, 0xc0, 0x00, 0x00, 0x00, 0x00, 0x7e, 0x03, 0xff, 0xf0, 0x00, 0x00, 
	0x00, 0x01, 0xff, 0xff, 0xff, 0xfc, 0x00, 0x00, 0x00, 0x07, 0x3f, 0xff, 0xf0, 0x0f, 0x00, 0x00, 
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	0x00, 0x00, 0x00, 0x3f, 0xe0, 0x00, 0x00, 0x00
};


// 'sfluna3', 61x61px
const unsigned char sfluna3 [] PROGMEM = {
	0x00, 0x00, 0x00, 0x3f, 0xe0, 0x00, 0x00, 0x00, 0x00, 0x00, 0x03, 0xfe, 0xfe, 0x00, 0x00, 0x00, 
	0x00, 0x00, 0x1d, 0xfd, 0xff, 0xc0, 0x00, 0x00, 0x00, 0x00, 0x7e, 0x03, 0xfe, 0xf0, 0x00, 0x00, 
	0x00, 0x01, 0xff, 0xff, 0xfd, 0xfc, 0x00, 0x00, 0x00, 0x07, 0x3f, 0xff, 0xf3, 0xff, 0x00, 0x00, 
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	0x00, 0x00, 0x00, 0x3f, 0xe0, 0x00, 0x00, 0x00
};


// 'sfluna4', 61x61px
const unsigned char sfluna4 [] PROGMEM = {
	0x00, 0x00, 0x00, 0x3f, 0xe0, 0x00, 0x00, 0x00, 0x00, 0x00, 0x03, 0xfe, 0xfe, 0x00, 0x00, 0x00, 
	0x00, 0x00, 0x1d, 0xfd, 0xff, 0xc0, 0x00, 0x00, 0x00, 0x00, 0x7e, 0x03, 0xfe, 0xf0, 0x00, 0x00, 
	0x00, 0x01, 0xff, 0xff, 0xfd, 0xfc, 0x00, 0x00, 0x00, 0x07, 0x3f, 0xff, 0xf3, 0xff, 0x00, 0x00, 
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	0x00, 0x00, 0x00, 0x3f, 0xe0, 0x00, 0x00, 0x00
};


// 'sfluna5', 61x61px
const unsigned char sfluna5 [] PROGMEM = {
	0x00, 0x00, 0x00, 0x3f, 0xe0, 0x00, 0x00, 0x00, 0x00, 0x00, 0x03, 0xfe, 0xfe, 0x00, 0x00, 0x00, 
	0x00, 0x00, 0x1d, 0xfd, 0xff, 0xc0, 0x00, 0x00, 0x00, 0x00, 0x7e, 0x03, 0xfe, 0xf0, 0x00, 0x00, 
	0x00, 0x01, 0xff, 0xff, 0xfd, 0xfc, 0x00, 0x00, 0x00, 0x07, 0x3f, 0xff, 0xf3, 0xff, 0x00, 0x00, 
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	0x00, 0x00, 0x00, 0x3f, 0xe0, 0x00, 0x00, 0x00
};


// 'sfluna6', 61x61px
const unsigned char sfluna6 [] PROGMEM = {
	0x00, 0x00, 0x00, 0x3f, 0xe0, 0x00, 0x00, 0x00, 0x00, 0x00, 0x03, 0xfe, 0xfe, 0x00, 0x00, 0x00, 
	0x00, 0x00, 0x1f, 0xfd, 0xff, 0xc0, 0x00, 0x00, 0x00, 0x00, 0x7e, 0x03, 0xfe, 0xf0, 0x00, 0x00, 
	0x00, 0x01, 0xff, 0xff, 0xfd, 0xfc, 0x00, 0x00, 0x00, 0x07, 0x3f, 0xff, 0xf3, 0xff, 0x00, 0x00, 
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	0x00, 0x00, 0x00, 0x3f, 0xe0, 0x00, 0x00, 0x00
};


// 'sfluna7', 61x61px
const unsigned char sfluna7 [] PROGMEM = {
	0x00, 0x00, 0x00, 0x3f, 0xe0, 0x00, 0x00, 0x00, 0x00, 0x00, 0x03, 0xfe, 0xfe, 0x00, 0x00, 0x00, 
	0x00, 0x00, 0x1d, 0xfd, 0xff, 0xc0, 0x00, 0x00, 0x00, 0x00, 0x7e, 0x03, 0xfe, 0xf0, 0x00, 0x00, 
	0x00, 0x01, 0xff, 0xff, 0xfd, 0xfc, 0x00, 0x00, 0x00, 0x07, 0x3f, 0xff, 0xf3, 0xff, 0x00, 0x00, 
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	0x00, 0x00, 0x00, 0x3f, 0xe0, 0x00, 0x00, 0x00
};


// 'sfluna8', 61x61px
const unsigned char sfluna8 [] PROGMEM = {
	0x00, 0x00, 0x00, 0x3f, 0xe0, 0x00, 0x00, 0x00, 0x00, 0x00, 0x03, 0xc1, 0x1e, 0x00, 0x00, 0x00, 
	0x00, 0x00, 0x1e, 0x02, 0x01, 0xc0, 0x00, 0x00, 0x00, 0x00, 0x61, 0xfc, 0x00, 0x30, 0x00, 0x00, 
	0x00, 0x01, 0x80, 0x00, 0x0f, 0xfc, 0x00, 0x00, 0x00, 0x06, 0xc0, 0x00, 0x73, 0xff, 0x00, 0x00, 
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	0x00, 0x00, 0x00, 0x7f, 0xe0, 0x00, 0x00, 0x00
};


// 'sfluna9', 61x61px
const unsigned char sfluna9 [] PROGMEM = {
	0x00, 0x00, 0x00, 0x3f, 0xe0, 0x00, 0x00, 0x00, 0x00, 0x00, 0x03, 0xc1, 0x1e, 0x00, 0x00, 0x00, 
	0x00, 0x00, 0x1c, 0x02, 0x01, 0xc0, 0x00, 0x00, 0x00, 0x00, 0x61, 0xfc, 0x01, 0x30, 0x00, 0x00, 
	0x00, 0x01, 0x80, 0x00, 0x02, 0x0c, 0x00, 0x00, 0x00, 0x06, 0xc0, 0x00, 0x0c, 0x03, 0x00, 0x00, 
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	0x00, 0x00, 0x00, 0x3f, 0xe0, 0x00, 0x00, 0x00
};


// 'sfluna10', 61x61px
const unsigned char sfluna10 [] PROGMEM = {
	0x00, 0x00, 0x00, 0x3f, 0xe0, 0x00, 0x00, 0x00, 0x00, 0x00, 0x03, 0xc1, 0x1e, 0x00, 0x00, 0x00, 
	0x00, 0x00, 0x1e, 0x02, 0x01, 0xc0, 0x00, 0x00, 0x00, 0x00, 0x61, 0xfc, 0x01, 0x30, 0x00, 0x00, 
	0x00, 0x01, 0x80, 0x00, 0x02, 0x0c, 0x00, 0x00, 0x00, 0x06, 0xc0, 0x00, 0x0c, 0x03, 0x00, 0x00, 
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	0x00, 0x00, 0x00, 0x3f, 0xe0, 0x00, 0x00, 0x00
};


// 'sfluna11', 61x61px
const unsigned char sfluna11 [] PROGMEM = {
	0x00, 0x00, 0x00, 0x3f, 0xe0, 0x00, 0x00, 0x00, 0x00, 0x00, 0x03, 0xc1, 0x1e, 0x00, 0x00, 0x00, 
	0x00, 0x00, 0x1e, 0x02, 0x01, 0xc0, 0x00, 0x00, 0x00, 0x00, 0x61, 0xfc, 0x01, 0x30, 0x00, 0x00, 
	0x00, 0x01, 0x80, 0x00, 0x02, 0x0c, 0x00, 0x00, 0x00, 0x06, 0xc0, 0x00, 0x0c, 0x03, 0x00, 0x00, 
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	0x00, 0x00, 0x00, 0x3f, 0xe0, 0x00, 0x00, 0x00
};



// 'sfluna12', 61x61px
const unsigned char sfluna12 [] PROGMEM = {
	0x00, 0x00, 0x00, 0x3f, 0xe0, 0x00, 0x00, 0x00, 0x00, 0x00, 0x03, 0xc1, 0x1e, 0x00, 0x00, 0x00, 
	0x00, 0x00, 0x1e, 0x02, 0x01, 0xc0, 0x00, 0x00, 0x00, 0x00, 0x61, 0xfc, 0x01, 0x30, 0x00, 0x00, 
	0x00, 0x01, 0x80, 0x00, 0x02, 0x0c, 0x00, 0x00, 0x00, 0x06, 0xc0, 0x00, 0x0c, 0x03, 0x00, 0x00, 
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	0x00, 0x00, 0x00, 0x3f, 0xe0, 0x00, 0x00, 0x00
};


// '0', 3x5px
const unsigned char sfnum_0 [] PROGMEM = {
	0xe0, 0xa0, 0xa0, 0xa0, 0xe0
};

// '1', 3x5px
const unsigned char sfnum_1 [] PROGMEM = {
	0xc0, 0x40, 0x40, 0x40, 0xe0
};

// '2', 3x5px
const unsigned char sfnum_2 [] PROGMEM = {
	0xe0, 0x20, 0xe0, 0x80, 0xe0
};

// '3', 3x5px
const unsigned char sfnum_3 [] PROGMEM = {
	0xe0, 0x20, 0xe0, 0x20, 0xe0
};

// '4', 3x5px
const unsigned char sfnum_4 [] PROGMEM = {
	0xa0, 0xa0, 0xe0, 0x20, 0x20
};

// '5', 3x5px
const unsigned char sfnum_5 [] PROGMEM = {
	0xe0, 0x80, 0xe0, 0x20, 0xe0
};

// '6', 3x5px
const unsigned char sfnum_6 [] PROGMEM = {
	0xe0, 0x80, 0xe0, 0xa0, 0xe0
};

// '7', 3x5px
const unsigned char sfnum_7 [] PROGMEM = {
	0xe0, 0x20, 0x20, 0x20, 0x20
};

// '8', 3x5px
const unsigned char sfnum_8 [] PROGMEM = {
	0xe0, 0xa0, 0xe0, 0xa0, 0xe0
};

// '9', 3x5px
const unsigned char sfnum_9 [] PROGMEM = {
	0xe0, 0xa0, 0xe0, 0x20, 0xe0
};

const unsigned char *sfnum_all [10] = { sfnum_0, sfnum_1, sfnum_2, sfnum_3, sfnum_4, sfnum_5, sfnum_6, sfnum_7, sfnum_8, sfnum_9 };

// 'arr', 3x5px
const unsigned char sfarr [] PROGMEM = {
  0x80, 0xc0, 0xe0, 0xc0, 0x80
};


// 'sffd_0', 33x53px
const unsigned char sffd_0 [] PROGMEM = {
	0x03, 0xff, 0xff, 0xe0, 0x00, 0x0f, 0xff, 0xff, 0xf8, 0x00, 0x1f, 0xff, 0xff, 0xfc, 0x00, 0x3f, 
	0xff, 0xff, 0xfe, 0x00, 0x7f, 0xff, 0xff, 0xff, 0x00, 0x7f, 0xff, 0xff, 0xff, 0x00, 0xff, 0x80, 
	0x00, 0xff, 0x80, 0xff, 0x00, 0x00, 0x7f, 0x80, 0xfe, 0x00, 0x00, 0x3f, 0x80, 0xfc, 0x00, 0x00, 
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	0xff, 0xff, 0xf8, 0x00, 0x03, 0xff, 0xff, 0xe0, 0x00
};

// 'sffd_1', 33x53px
const unsigned char sffd_1 [] PROGMEM = {
	0x7f, 0xff, 0xe0, 0x00, 0x00, 0xff, 0xff, 0xf0, 0x00, 0x00, 0xff, 0xff, 0xf0, 0x00, 0x00, 0xff, 
	0xff, 0xf0, 0x00, 0x00, 0xff, 0xff, 0xf0, 0x00, 0x00, 0x7f, 0xff, 0xf0, 0x00, 0x00, 0x00, 0x03, 
	0xf0, 0x00, 0x00, 0x00, 0x03, 0xf0, 0x00, 0x00, 0x00, 0x03, 0xf0, 0x00, 0x00, 0x00, 0x03, 0xf0, 
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	0xff, 0xff, 0xff, 0x80, 0x7f, 0xff, 0xff, 0xff, 0x00
};

// 'sffd_2', 33x53px
const unsigned char sffd_2 [] PROGMEM = {
	0x01, 0xff, 0xff, 0xc0, 0x00, 0x07, 0xff, 0xff, 0xf0, 0x00, 0x0f, 0xff, 0xff, 0xf8, 0x00, 0x1f, 
	0xff, 0xff, 0xfc, 0x00, 0x3f, 0xff, 0xff, 0xfe, 0x00, 0x7f, 0xff, 0xff, 0xff, 0x00, 0x7f, 0x00, 
	0x00, 0xff, 0x00, 0xfe, 0x00, 0x00, 0x7f, 0x80, 0xfc, 0x00, 0x00, 0x3f, 0x80, 0xfc, 0x00, 0x00, 
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	0xff, 0xff, 0xff, 0x80, 0x3f, 0xff, 0xff, 0xff, 0x00
};

// 'sffd_3', 33x53px
const unsigned char sffd_3 [] PROGMEM = {
	0x03, 0xff, 0xff, 0xe0, 0x00, 0x0f, 0xff, 0xff, 0xf8, 0x00, 0x1f, 0xff, 0xff, 0xfc, 0x00, 0x3f, 
	0xff, 0xff, 0xfe, 0x00, 0x7f, 0xff, 0xff, 0xff, 0x00, 0x7f, 0xff, 0xff, 0xff, 0x00, 0xfe, 0x00, 
	0x00, 0xff, 0x80, 0xfc, 0x00, 0x00, 0x7f, 0x80, 0xfc, 0x00, 0x00, 0x3f, 0x80, 0xfc, 0x00, 0x00, 
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	0xff, 0xff, 0xf8, 0x00, 0x03, 0xff, 0xff, 0xe0, 0x00
};

// 'sffd_4', 33x53px
const unsigned char sffd_4 [] PROGMEM = {
	0x00, 0x1e, 0x00, 0x00, 0x00, 0x00, 0x3f, 0x00, 0x00, 0x00, 0x00, 0x3f, 0x00, 0x00, 0x00, 0x00, 
	0x7f, 0x00, 0x00, 0x00, 0x00, 0x7e, 0x00, 0x00, 0x00, 0x00, 0xfe, 0x00, 0x00, 0x00, 0x00, 0xfc, 
	0x00, 0x00, 0x00, 0x01, 0xfc, 0x00, 0x00, 0x00, 0x01, 0xf8, 0x00, 0x00, 0x00, 0x03, 0xf8, 0x00, 
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	0x00, 0x3f, 0x00, 0x00, 0x00, 0x00, 0x1e, 0x00, 0x00
};

// 'sffd_5', 33x53px
const unsigned char sffd_5 [] PROGMEM = {
	0x7f, 0xff, 0xff, 0xff, 0x00, 0xff, 0xff, 0xff, 0xff, 0x80, 0xff, 0xff, 0xff, 0xff, 0x80, 0xff, 
	0xff, 0xff, 0xff, 0x80, 0xff, 0xff, 0xff, 0xff, 0x80, 0xff, 0xff, 0xff, 0xff, 0x00, 0xfc, 0x00, 
	0x00, 0x00, 0x00, 0xfc, 0x00, 0x00, 0x00, 0x00, 0xfc, 0x00, 0x00, 0x00, 0x00, 0xfc, 0x00, 0x00, 
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	0xff, 0xff, 0xf0, 0x00, 0x03, 0xff, 0xff, 0xc0, 0x00
};

// 'sffd_6', 33x53px
const unsigned char sffd_6 [] PROGMEM = {
	0x00, 0x01, 0xe0, 0x00, 0x00, 0x00, 0x03, 0xf0, 0x00, 0x00, 0x00, 0x03, 0xf0, 0x00, 0x00, 0x00, 
	0x07, 0xf0, 0x00, 0x00, 0x00, 0x07, 0xe0, 0x00, 0x00, 0x00, 0x0f, 0xe0, 0x00, 0x00, 0x00, 0x0f, 
	0xc0, 0x00, 0x00, 0x00, 0x1f, 0xc0, 0x00, 0x00, 0x00, 0x1f, 0x80, 0x00, 0x00, 0x00, 0x3f, 0x80, 
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	0xff, 0xff, 0xf8, 0x00, 0x03, 0xff, 0xff, 0xe0, 0x00
};

// 'sffd_7', 33x53px
const unsigned char sffd_7 [] PROGMEM = {
	0x7f, 0xff, 0xff, 0xff, 0x00, 0xff, 0xff, 0xff, 0xff, 0x80, 0xff, 0xff, 0xff, 0xff, 0x80, 0xff, 
	0xff, 0xff, 0xff, 0x80, 0xff, 0xff, 0xff, 0xff, 0x80, 0x7f, 0xff, 0xff, 0xff, 0x80, 0x00, 0x00, 
	0x00, 0x3f, 0x80, 0x00, 0x00, 0x00, 0x1f, 0x80, 0x00, 0x00, 0x00, 0x1f, 0x80, 0x00, 0x00, 0x00, 
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	0x3f, 0x00, 0x00, 0x00, 0x00, 0x1e, 0x00, 0x00, 0x00
};

// 'sffd_8', 33x53px
const unsigned char sffd_8 [] PROGMEM = {
  0x03, 0xff, 0xff, 0xe0, 0x00, 0x0f, 0xff, 0xff, 0xf8, 0x00, 0x1f, 0xff, 0xff, 0xfc, 0x00, 0x3f, 
  0xff, 0xff, 0xfe, 0x00, 0x7f, 0xff, 0xff, 0xff, 0x00, 0x7f, 0xff, 0xff, 0xff, 0x00, 0xff, 0x80, 
  0x00, 0xff, 0x80, 0xff, 0x00, 0x00, 0x7f, 0x80, 0xfe, 0x00, 0x00, 0x3f, 0x80, 0xfc, 0x00, 0x00, 
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  0xff, 0xff, 0xf8, 0x00, 0x03, 0xff, 0xff, 0xe0, 0x00
};

// 'sffd_9', 33x53px
const unsigned char sffd_9 [] PROGMEM = {
	0x03, 0xff, 0xff, 0xe0, 0x00, 0x0f, 0xff, 0xff, 0xf8, 0x00, 0x1f, 0xff, 0xff, 0xfc, 0x00, 0x3f, 
	0xff, 0xff, 0xfe, 0x00, 0x7f, 0xff, 0xff, 0xff, 0x00, 0x7f, 0xff, 0xff, 0xff, 0x00, 0xff, 0x80, 
	0x00, 0xff, 0x80, 0xff, 0x00, 0x00, 0x7f, 0x80, 0xfe, 0x00, 0x00, 0x3f, 0x80, 0xfc, 0x00, 0x00, 
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	0x07, 0xe0, 0x00, 0x00, 0x00, 0x03, 0xc0, 0x00, 0x00
};

const unsigned char *sffd_all [10] = { sffd_0, sffd_1, sffd_2, sffd_3, sffd_4, sffd_5, sffd_6, sffd_7, sffd_8, sffd_9 };

// 'sfdd_0', 16x25px
const unsigned char sfdd_0 [] PROGMEM = {
	0x3f, 0xfc, 0x7f, 0xfe, 0xff, 0xff, 0xf0, 0x0f, 0xe0, 0x07, 0xe0, 0x07, 0xe0, 0x0f, 0xe0, 0x1f, 
	0xe0, 0x3f, 0xe0, 0x7f, 0xe0, 0xf7, 0xe1, 0xe7, 0xe3, 0xc7, 0xe7, 0x87, 0xef, 0x07, 0xfe, 0x07, 
	0xfc, 0x07, 0xf8, 0x07, 0xf0, 0x07, 0xe0, 0x07, 0xe0, 0x07, 0xf0, 0x0f, 0xff, 0xff, 0x7f, 0xfe, 
	0x3f, 0xfc
};

// 'sfdd_1', 16x25px
const unsigned char sfdd_1 [] PROGMEM = {
	0xff, 0x00, 0xff, 0x80, 0xff, 0x80, 0x03, 0x80, 0x03, 0x80, 0x03, 0x80, 0x03, 0x80, 0x03, 0x80, 
	0x03, 0x80, 0x03, 0x80, 0x03, 0x80, 0x03, 0x80, 0x03, 0x80, 0x03, 0x80, 0x03, 0x80, 0x03, 0x80, 
	0x03, 0x80, 0x03, 0x80, 0x03, 0x80, 0x03, 0x80, 0x03, 0x80, 0x03, 0x80, 0xff, 0xff, 0xff, 0xff, 
	0xff, 0xff
};

// 'sfdd_2', 16x25px
const unsigned char sfdd_2 [] PROGMEM = {
	0x1f, 0xf8, 0x3f, 0xfc, 0x7f, 0xfe, 0xf0, 0x0f, 0xe0, 0x07, 0xe0, 0x07, 0x40, 0x07, 0x00, 0x07, 
	0x00, 0x0f, 0x00, 0x1e, 0x00, 0x7c, 0x01, 0xf8, 0x07, 0xe0, 0x1f, 0x80, 0x3e, 0x00, 0x78, 0x00, 
	0xf0, 0x00, 0xe0, 0x00, 0xe0, 0x00, 0xe0, 0x00, 0xe0, 0x00, 0xe0, 0x00, 0xff, 0xff, 0xff, 0xff, 
	0x7f, 0xff
};

// 'sfdd_3', 16x25px
const unsigned char sfdd_3 [] PROGMEM = {
	0x3f, 0xfc, 0x7f, 0xfe, 0xff, 0xff, 0xf0, 0x0f, 0xe0, 0x07, 0xe0, 0x07, 0x00, 0x07, 0x00, 0x07, 
	0x00, 0x07, 0x00, 0x07, 0x00, 0x0f, 0x07, 0xfe, 0x0f, 0xfc, 0x07, 0xfe, 0x00, 0x0f, 0x00, 0x07, 
	0x00, 0x07, 0x00, 0x07, 0x00, 0x07, 0xe0, 0x07, 0xe0, 0x07, 0xf0, 0x0f, 0xff, 0xff, 0x7f, 0xfe, 
	0x3f, 0xfc
};

// 'sfdd_4', 16x25px
const unsigned char sfdd_4 [] PROGMEM = {
	0x07, 0x00, 0x07, 0x00, 0x0f, 0x00, 0x0e, 0x00, 0x1e, 0x00, 0x1c, 0x00, 0x3c, 0x00, 0x38, 0x00, 
	0x78, 0x00, 0x70, 0x00, 0xf0, 0x00, 0xe0, 0xe0, 0xe0, 0xe0, 0xe0, 0xe0, 0xe0, 0xe0, 0xe0, 0xe0, 
	0xff, 0xff, 0xff, 0xff, 0x7f, 0xff, 0x00, 0xe0, 0x00, 0xe0, 0x00, 0xe0, 0x00, 0xe0, 0x00, 0xe0, 
	0x00, 0xe0
};

// 'sfdd_5', 16x25px
const unsigned char sfdd_5 [] PROGMEM = {
	0xff, 0xff, 0xff, 0xff, 0xff, 0xff, 0xe0, 0x00, 0xe0, 0x00, 0xe0, 0x00, 0xe0, 0x00, 0xe0, 0x00, 
	0xe0, 0x00, 0xe0, 0x00, 0xe0, 0x00, 0xff, 0xfc, 0xff, 0xfe, 0x7f, 0xff, 0x00, 0x0f, 0x00, 0x07, 
	0x00, 0x07, 0x00, 0x07, 0x00, 0x07, 0xe0, 0x07, 0xe0, 0x07, 0xf0, 0x0f, 0xff, 0xfe, 0x7f, 0xfc, 
	0x3f, 0xf8
};

// 'sfdd_6', 16x25px
const unsigned char sfdd_6 [] PROGMEM = {
	0x01, 0xc0, 0x03, 0xc0, 0x03, 0x80, 0x07, 0x80, 0x07, 0x00, 0x0f, 0x00, 0x0e, 0x00, 0x1e, 0x00, 
	0x1c, 0x00, 0x3c, 0x00, 0x38, 0x00, 0x7f, 0xfc, 0x7f, 0xfe, 0xff, 0xff, 0xf0, 0x0f, 0xe0, 0x07, 
	0xe0, 0x07, 0xe0, 0x07, 0xe0, 0x07, 0xe0, 0x07, 0xe0, 0x07, 0xf0, 0x0f, 0xff, 0xff, 0x7f, 0xfe, 
	0x3f, 0xfc
};

// 'sfdd_7', 16x25px
const unsigned char sfdd_7 [] PROGMEM = {
	0xff, 0xff, 0xff, 0xff, 0xff, 0xff, 0x00, 0x07, 0x00, 0x07, 0x00, 0x0f, 0x00, 0x0f, 0x00, 0x1e, 
	0x00, 0x1c, 0x00, 0x3c, 0x00, 0x38, 0x00, 0x78, 0x00, 0x70, 0x00, 0xf0, 0x00, 0xe0, 0x01, 0xe0, 
	0x01, 0xc0, 0x03, 0xc0, 0x03, 0x80, 0x07, 0x80, 0x07, 0x00, 0x07, 0x00, 0x07, 0x00, 0x07, 0x00, 
	0x07, 0x00
};

// 'sfdd_8', 16x25px
const unsigned char sfdd_8 [] PROGMEM = {
	0x3f, 0xfc, 0x7f, 0xfe, 0xff, 0xff, 0xf0, 0x0f, 0xe0, 0x07, 0xe0, 0x07, 0xe0, 0x07, 0xe0, 0x07, 
	0xe0, 0x07, 0xe0, 0x07, 0xf0, 0x0f, 0x7f, 0xfe, 0x3f, 0xfc, 0x7f, 0xfe, 0xf0, 0x0f, 0xe0, 0x07, 
	0xe0, 0x07, 0xe0, 0x07, 0xe0, 0x07, 0xe0, 0x07, 0xe0, 0x07, 0xf0, 0x0f, 0xff, 0xff, 0x7f, 0xfe, 
	0x3f, 0xfc
};

// 'sfdd_9', 16x25px
const unsigned char sfdd_9 [] PROGMEM = {
	0x3f, 0xfc, 0x7f, 0xfe, 0xff, 0xff, 0xf0, 0x0f, 0xe0, 0x07, 0xe0, 0x07, 0xe0, 0x07, 0xe0, 0x07, 
	0xe0, 0x07, 0xe0, 0x07, 0xf0, 0x0f, 0xff, 0xff, 0x7f, 0xfe, 0x3f, 0xfe, 0x00, 0x1c, 0x00, 0x3c, 
	0x00, 0x38, 0x00, 0x78, 0x00, 0x70, 0x00, 0xf0, 0x00, 0xe0, 0x01, 0xe0, 0x01, 0xc0, 0x03, 0xc0, 
	0x03, 0x80
};

const unsigned char *sfdd_all [10] = { sfdd_0, sfdd_1, sfdd_2, sfdd_3, sfdd_4, sfdd_5, sfdd_6, sfdd_7, sfdd_8, sfdd_9 };

// 'am', 25x9px
const unsigned char sfam [] PROGMEM = {
	0xff, 0xff, 0xff, 0x80, 0xff, 0xf8, 0x00, 0x80, 0xc4, 0x1b, 0xbe, 0x80, 0xd5, 0x5a, 0xaa, 0x80, 
	0xc5, 0x5b, 0xaa, 0x80, 0xd5, 0x5a, 0x2a, 0x80, 0xd5, 0x5a, 0x2a, 0x80, 0xff, 0xf8, 0x00, 0x80, 
	0xff, 0xff, 0xff, 0x80
};

// 'pm', 25x9px
const unsigned char sfpm [] PROGMEM = {
	0xff, 0xff, 0xff, 0x80, 0x80, 0x0f, 0xff, 0x80, 0xbb, 0xec, 0x41, 0x80, 0xaa, 0xad, 0x55, 0x80, 
	0xba, 0xac, 0x55, 0x80, 0xaa, 0xad, 0xd5, 0x80, 0xaa, 0xad, 0xd5, 0x80, 0x80, 0x0f, 0xff, 0x80, 
	0xff, 0xff, 0xff, 0x80
};

// Place all your Variables here.
RTC_DATA_ATTR uint8_t StarSunFieldWatchFaceStyle;  // Remember RTC_DATA_ATTR for your variables so they don't get wiped on deep sleep.

float _d2dlatitude, _d2dlongitude;
int   _d2dtimezone;

// If you want more than one WatchFaceStyle, make more variables and be sure to register them below in RegisterWatchFaces().

// This is used to keep track of times you're in various looping functions (like AskForWiFi calling InsertWiFi).
// Use more of these type of variables with the looping functions for various WatchFace Styles in this file.
// Looping variables don't necessarily need RTC_DATA_ATTR, unless you're using this variable during deep sleep minute wakes.
int StarSunFieldWatchFaceState = 0;

class StarSunFieldWatchClassClass : public WatchyGSR {
/*
 * Keep your functions inside the class, but at the bottom to avoid confusion.
 * Be sure to visit https://github.com/GuruSR/Watchy_GSR/blob/main/Override%20Information.md for full information on AddOns.
 * Overriding is not possible with an AddOn, you only have access to most of the Insert style functions.
 * The full available range of WatchyGSR public functions and data elements are available, you do not need to use WatchyGSR:: at the start.
 * Design elements do have a WatchyGSR:: at the start to specify those elements from WatchyGSR, if there is confusion with the compiler, use
 * WatchyGSR:: in front of items it can't distinguish or rename the ones you've added in this file to avoid the issue.
 */

    public:
    StarSunFieldWatchClassClass() : WatchyGSR() { initAddOn(this); } // *** DO NOT EDIT THE CONTENTS OF THIS FUNCTION ***


// This function is required by AddOns and is used to register one or more WatchFace Styles at startup, you can add more here, but you need more variables above
// to track all of the WatchFaces and determine which ones match the CurrentStyleID(), as WatchFace Styles are collected and assigned at boot.

    void RegisterWatchFaces(){
      StarSunFieldWatchFaceStyle = AddWatchStyle("Starfield",this);
    };


// This function sets up the WatchFace Styles, this is required for AddOns,
// as it sets up the Style when it is called for the first time and each time the Watchy is switched to another Watchface.

    void InsertInitWatchStyle(uint8_t StyleID){
      if (StyleID == StarSunFieldWatchFaceStyle){
          //OverrideDefaultMenu(true);
          //WantWeather(true);
          NoAlarmStatus(true);
					UseMyWiFiIcon(sfWiFiOff, sfWiFiOn, 25, 18);
          Design.Status.Inverted = false;
          Design.Status.WIFIx = 118;
          Design.Status.WIFIy = 186;
          Design.Status.BatteryInverted = false;
          Design.Status.BATTx = 155;
          Design.Status.BATTy = 169;
      }
    };

// This function will draw the WatchFace on the screen, drawStatus and drawChargeMe functions are done elsewhere and do not need to be done here.
// This function is required for AddOns, otherwise there will be no drawing of the Watchface.
 
    void InsertDrawWatchStyle(uint8_t StyleID){
      if (StyleID == StarSunFieldWatchFaceStyle){
            if (SafeToDraw()){
                drawFiel ();
                drawTime();
                drawDate();
                drawSteps();
								drawBattery();
                drawMoon();
                drawSun();
                drawStatus();
            }
      }
    };


/* This function can be used to return your favorite NTP server.  CurrentStyleID() can be used here to separate between Styles.

    String InsertNTPServer() { return "myfavntpserver"; }
*/


/* This function will run on each new minute.  CurrentStyleID() can be used here to separate between Styles.

    void InsertOnMinute(){
    };
*/


/* This function is called when you've asked for WiFi and no other processes are using it.  CurrentStyleID() can be used here to separate between Styles.

    void InsertWiFi(){
    };
*/

/* This function is called when WiFi is ending, clean up after your code, if it is StyleID specific, use CurrentStyleID() to read the current StyleID.

    void InsertWiFiEnding(){
    };
*/


/* This function is useful to draw the Weather on the screen, if Status is true, means the Watchy_GSR status area asked for the icons to be placed there, use the Design.Status.WIFIx and WIFIy for positioning.

void InsertDrawWeather(uint8_t StyleID, bool Status) {}
*/


/* This function is used to tell WatchyGSR that you need it to stay in Active Mode (true), so you can keep the Watchy from deep sleeping.
// CurrentStyleID() can be used here to separate between Styles.

 bool InsertNeedAwake(bool GoingAsleep) { return false; }
*/


/* This function is used when wanting buttons not being used by the Menu system and/or if you're overriding the Menu system, BUTTON MIXING works here.
// CurrentStyleID() can be used here to separate between Styles.

    bool InsertHandlePressed(uint8_t SwitchNumber, bool &Haptic, bool &Refresh) {
      switch (SwitchNumber){
        case 2: //Back
          return true;  // Respond with "I used a button", so the WatchyGSR knows you actually did something with a button.
          break;
        case 3: //Up
          State = 0;
          AskForWiFi();
          Haptic = true;  // Cause Haptic feedback if set to true.
          Refresh = true; // Cause the screen to be refreshed (redrawn).
          return true;
          break;
        case 4: //Down
          display.setCursor(0,16);
          display.print("Down");
          display.display(true);
          return true;
      }
      return false;
    };
*/


/* This function can be used to override the Design's Bitmap setting.  CurrentStyleID() can be used here to separate between Styles.

    bool OverrideBitmap(){ return false; };
*/


/* This function can be used to override the Design's SleepBitmap setting.  CurrentStyleID() can be used here to separate between Styles.

    bool OverrideSleepBitmap(){ return false; }
*/


   // Original Watchy.cpp code from StarField watch face.

   void drawTime()
   {
       display.setFont(&DSEG7_Classic_Bold_53);
       display.setCursor(6, 53+5);
       int sh = WatchTime.Local.Hour;
			 int sm = WatchTime.Local.Minute;
			 bool am = IsAM();

       if (!Is24HourMode())
       {
           display.fillRect(7, 60, 25, 9, BackColor());
           display.drawBitmap(7, 60, (am ? sfam : sfpm), 25, 9, ForeColor());

           if (sh > 12)
           {
               sh -= 12;
           }else if (!sh && am)
					 {
							 sh = 12;
					 }
       }
       int a = sh >= 10 ? sh / 10 : 0;
       int b = sh % 10;
       int c = sm >= 10 ? sm / 10 : 0;
       int d = sm % 10;

       display.drawBitmap(11, 5, sffd_all[a], 33, 53, ForeColor());
       display.drawBitmap(55, 5, sffd_all[b], 33, 53, ForeColor());
       display.drawBitmap(111, 5, sffd_all[c], 33, 53, ForeColor());
       display.drawBitmap(155, 5, sffd_all[d], 33, 53, ForeColor());

   }

   void drawDate()
   {
       display.setFont(&Seven_Segment10pt7b);

       int16_t  x1, y1;
       uint16_t w, h;

       String dayOfWeek = dayStr(WatchTime.Local.Wday + 1);
       dayOfWeek = dayOfWeek.substring(0, dayOfWeek.length() - 3);
       display.getTextBounds(dayOfWeek, 5, 85, &x1, &y1, &w, &h);
       if(WatchTime.Local.Wday == 3)
       {
           w -= 5;
       }
       display.setCursor(76 - w, 86);
       display.println(dayOfWeek);

       String month = monthShortStr(WatchTime.Local.Month + 1);
       display.getTextBounds(month, 60, 110, &x1, &y1, &w, &h);
       display.setCursor(79 - w, 110);
       display.println(month);

       int da = WatchTime.Local.Day;
       int ye = WatchTime.Local.Year + SRTC.getLocalYearOffset();

       int a = da / 10;
       int b = da % 10;
       int c = ye / 1000;
       ye = ye % 1000;
       int d = ye / 100;
       ye = ye % 100;
       int e = ye / 10;
       ye = ye % 10;
       int f = ye;

       display.drawBitmap(8, 95, sfdd_all[a], 16, 25, ForeColor());
       display.drawBitmap(29, 95, sfdd_all[b], 16, 25, ForeColor());
       display.drawBitmap(8, 129, sfdd_all[c], 16, 25, ForeColor());
       display.drawBitmap(29, 129, sfdd_all[d], 16, 25, ForeColor());
       display.drawBitmap(50, 129, sfdd_all[e], 16, 25, ForeColor());
       display.drawBitmap(71, 129, sfdd_all[f], 16, 25, ForeColor());

   }

   void drawSteps()
   {
       uint32_t stepCount = CurrentStepCount();
       uint32_t l5 = 61 * stepCount / 10000;

       if (l5 > 61)
       {
           l5 = 61;
       }

       display.fillRect(131, 148, l5, 9, ForeColor());

       int a = stepCount / 10000;
       stepCount = stepCount % 10000;
       int b = stepCount / 1000;
       stepCount = stepCount % 1000;
       int c = stepCount / 100;
       stepCount = stepCount % 100;
       int d = stepCount / 10;
       int e = stepCount % 10;

       display.drawBitmap(8, 165, sfdd_all[a], 16, 25, ForeColor());
       display.drawBitmap(29, 165, sfdd_all[b], 16, 25, ForeColor());
       display.drawBitmap(50, 165, sfdd_all[c], 16, 25, ForeColor());
       display.drawBitmap(71, 165, sfdd_all[d], 16, 25, ForeColor());
       display.drawBitmap(92, 165, sfdd_all[e], 16, 25, ForeColor());

   }

   void drawBattery()
   {
       float VBAT = round(37 * (getBatteryVoltagePercent() / 100));
			 if (VBAT > 0 && getBatteryVoltage() > getLowBattery() && !getBatteryCharging())
   				 display.fillRect(155, 169, VBAT, 15, ForeColor());
			 else
			 {
			 		 display.fillRect(155, 169, 37, 15, BackColor());
					 drawChargeMe();
			 }
   }

   void drawFiel()
   {
       display.drawBitmap(0, 0, sffield, 200, 200, ForeColor());
   }

   void drawMoon() {
       moonData_t moon;     // variable to receive the data
       
       // January 31st, 2020 @ 1:30PM UTC
       int year = WatchTime.UTC.Year + SRTC.getLocalYearOffset();
       int32_t month = WatchTime.UTC.Month + 1;
       int32_t day = WatchTime.UTC.Day;
       double hour = WatchTime.UTC.Hour + 0.1;

       moon = _getPhase(year, month, day, hour);

       int ag = moon.angle;
       double lt = moon.percentLit;

       // Waxing: 0-180
       // Waning: 180-360

       if (ag <= 180)
       {
           if (lt < 0.1)
               display.drawBitmap(131, 74, sfluna1, 61, 61, ForeColor());
           else if (lt < 0.25)
               display.drawBitmap(131, 74, sfluna12, 61, 61, ForeColor());
           else if (lt < 0.4)
               display.drawBitmap(131, 74, sfluna11, 61, 61, ForeColor());
           else if (lt < 0.6)
               display.drawBitmap(131, 74, sfluna10, 61, 61, ForeColor());
           else if (lt < 0.75)
               display.drawBitmap(131, 74, sfluna9, 61, 61, ForeColor());
           else if (lt < 0.9)
               display.drawBitmap(131, 74, sfluna8, 61, 61, ForeColor());
           else 
               display.drawBitmap(131, 74, sfluna7, 61, 61, ForeColor());
       }
       else
       {
           if (lt < 0.1)
               display.drawBitmap(131, 74, sfluna1, 61, 61, ForeColor());
           else if (lt < 0.25)
               display.drawBitmap(131, 74, sfluna2, 61, 61, ForeColor());
           else if (lt < 0.4)
               display.drawBitmap(131, 74, sfluna3, 61, 61, ForeColor());
           else if (lt < 0.6)
               display.drawBitmap(131, 74, sfluna4, 61, 61, ForeColor());
           else if (lt < 0.75)
               display.drawBitmap(131, 74, sfluna5, 61, 61, ForeColor());
           else if (lt < 0.9)
               display.drawBitmap(131, 74, sfluna6, 61, 61, ForeColor());
           else 
               display.drawBitmap(131, 74, sfluna7, 61, 61, ForeColor());
       }
   }

   void drawSun() {
       time_t t2; 
       struct tm *tm2;
       float dstoff;
       
       tm2 = gmtime(&WatchTime.UTC_RAW); // Convert to UTC time 
       tm2->tm_isdst = -1; 
       t2 = mktime(tm2); // Convert back to seconds 
       dstoff = ((WatchTime.UTC_RAW-t2)/3600);
       _d2dlatitude  = getWeatherLatitude();
       _d2dlongitude = getWeatherLongitude();
       _d2dtimezone  = dstoff;
       int year = WatchTime.UTC.Year + SRTC.getLocalYearOffset();
       int32_t month = WatchTime.UTC.Month + 1;
       int32_t day = WatchTime.UTC.Day;
       int sr = sunriseSet(true, year, month, day, false);
       int ss = sunriseSet(false, year, month, day, false);

       long k = WatchTime.UTC.Hour * 60 + WatchTime.UTC.Minute;
       int tk = (k - sr) * 60 / (ss - sr);
       if (k > ss)
           tk = 60;
       else if (k < sr)
           tk = 0;
       display.drawBitmap(110, 132 - tk, sfarr, 3, 5, ForeColor());

       int rh = sr / 60;
       int rm = sr % 60;
       int sh = ss / 60;
       int sm = ss % 60;

       if (!Is24HourMode() && rh > 12)
       {
           rh -= 12;
       }

       if (!Is24HourMode() && sh >12)
       {
           sh -= 12;
       }

       int a = sh >= 10 ? sh / 10 : 0;
       int b = sh % 10;
       int c = sm >= 10 ? sm / 10 : 0;
       int d = sm % 10;
       int e = rh >= 10 ? rh / 10 : 0;
       int f = rh % 10;
       int g = rm >= 10 ? rm / 10 : 0;
       int h = rm % 10;

           display.drawBitmap(116, 67, sfnum_all[a], 3, 5, ForeColor());
           display.drawBitmap(120, 67, sfnum_all[b], 3, 5, ForeColor());
           display.drawBitmap(128, 67, sfnum_all[c], 3, 5, ForeColor());
           display.drawBitmap(132, 67, sfnum_all[d], 3, 5, ForeColor());
           display.drawBitmap(116, 137, sfnum_all[e], 3, 5, ForeColor());
           display.drawBitmap(120, 137, sfnum_all[f], 3, 5, ForeColor());
           display.drawBitmap(128, 137, sfnum_all[g], 3, 5, ForeColor());
           display.drawBitmap(132, 137, sfnum_all[h], 3, 5, ForeColor());
   }

   /*  Dusk2Dawn.cpp
    *  Get time of sunrise and sunset.
    *  Created by DM Kishi <dm.kishi@gmail.com> on 2017-02-01.
    *  <https://github.com/dmkishi/Dusk2Dawn>
    */


   /******************************************************************************/
   /*                                   PUBLIC                                   */
   /******************************************************************************/
   /* Though most time zones are offset by whole hours, there are a few zones
    * offset by 30 or 45 minutes, so the argument must be declared as a float.
    */


   /******************************************************************************/
   /*                                  PRIVATE                                   */
   /******************************************************************************/
   int sunriseSet(bool isRise, int y, int m, int d, bool isDST) {
     float jday, newJday, timeUTC, newTimeUTC;
     int timeLocal;

     jday    = jDay(y, m, d);
     timeUTC = sunriseSetUTC(isRise, jday, _d2dlatitude, _d2dlongitude);

     // Advance the calculated time by a fraction of itself. I've no idea what the
     // purpose of this is.
     newJday    = jday + timeUTC / (60 * 24);
     newTimeUTC = sunriseSetUTC(isRise, newJday, _d2dlatitude, _d2dlongitude);

     if (!isnan(newTimeUTC)) {
       timeLocal  = (int) round(newTimeUTC + (_d2dtimezone * 60));
       timeLocal += (isDST) ? 60 : 0;
     } else {
       // There is no sunrise or sunset, e.g. it's in the (ant)arctic.
       timeLocal = -1;
     }

     return timeLocal;
   }


   float sunriseSetUTC(bool isRise, float jday, float latitude, float longitude) {
     float t         = fractionOfCentury(jday);
     float eqTime    = equationOfTime(t);
     float solarDec  = sunDeclination(t);
     float hourAngle = hourAngleSunrise(latitude, solarDec);

     hourAngle = isRise ? hourAngle : -hourAngle;
     float delta   = longitude + radToDeg(hourAngle);
     float timeUTC = 720 - (4 * delta) - eqTime; // in minutes
     return timeUTC;
   }


   /* ---------------------------- EQUATION OF TIME ---------------------------- */
   /* The difference between mean solar time (as shown by clocks) and apparent
    * solar time (indicated by sundials), which varies with the time of year.
    */
   float equationOfTime(float t) {
     float epsilon = obliquityCorrection(t);
     float l0      = geomMeanLongSun(t);
     float e       = eccentricityEarthOrbit(t);
     float m       = geomMeanAnomalySun(t);

     float y = tan(degToRad(epsilon) / 2);
     y *= y;

     float sin2l0 = sin(2.0 * degToRad(l0));
     float sinm   = sin(degToRad(m));
     float cos2l0 = cos(2.0 * degToRad(l0));
     float sin4l0 = sin(4.0 * degToRad(l0));
     float sin2m  = sin(2.0 * degToRad(m));

     float Etime = y * sin2l0 - 2.0 * e * sinm + 4.0 * e * y * sinm * cos2l0 - 0.5 * y * y * sin4l0 - 1.25 * e * e * sin2m;
     return radToDeg(Etime) * 4.0; // in minutes of time
   }


   /* Obliquity of the ecliptic is the term used by astronomers for the inclination
    * of Earth's equator with respect to the ecliptic, or of Earth's rotation axis
    * to a perpendicular to the ecliptic.
    */
   float meanObliquityOfEcliptic(float t) {
     float seconds = 21.448 - t * (46.8150 + t * (0.00059 - t * 0.001813));
     float e0      = 23 + (26 + (seconds / 60)) / 60;
     return e0; // in degrees
   }


   float eccentricityEarthOrbit(float t) {
     float e = 0.016708634 - t * (0.000042037 + 0.0000001267 * t);
     return e; // unitless
   }


   /* --------------------------- SOLAR DECLINATION ---------------------------- */
   float sunDeclination(float t) {
     float e      = obliquityCorrection(t);
     float lambda = sunApparentLong(t);

     float sint  = sin(degToRad(e)) * sin(degToRad(lambda));
     float theta = radToDeg(asin(sint));
     return theta; // in degrees
   }


   float sunApparentLong(float t) {
     float o      = sunTrueLong(t);
     float omega  = 125.04 - 1934.136 * t;
     float lambda = o - 0.00569 - 0.00478 * sin(degToRad(omega));
     return lambda; // in degrees
   }


   float sunTrueLong(float t) {
     float l0 = geomMeanLongSun(t);
     float c  = sunEqOfCenter(t);
     float O  = l0 + c;
     return O; // in degrees
   }


   float sunEqOfCenter(float t) {
     float m     = geomMeanAnomalySun(t);
     float mrad  = degToRad(m);
     float sinm  = sin(mrad);
     float sin2m = sin(mrad * 2);
     float sin3m = sin(mrad * 3);
     float C = sinm * (1.914602 - t * (0.004817 + 0.000014 * t)) + sin2m * (0.019993 - 0.000101 * t) + sin3m * 0.000289;
     return C; // in degrees
   }


   /* ------------------------------- HOUR ANGLE ------------------------------- */
   float hourAngleSunrise(float lat, float solarDec) {
     float latRad = degToRad(lat);
     float sdRad  = degToRad(solarDec);
     float HAarg  = (cos(degToRad(90.833)) / (cos(latRad) * cos(sdRad)) - tan(latRad) * tan(sdRad));
     float HA     = acos(HAarg);
     return HA; // in radians (for sunset, use -HA)
   }


   /* ---------------------------- SHARED FUNCTIONS ---------------------------- */
   float obliquityCorrection(float t) {
     float e0    = meanObliquityOfEcliptic(t);
     float omega = 125.04 - 1934.136 * t;
     float e     = e0 + 0.00256 * cos(degToRad(omega));
     return e; // in degrees
   }


   float geomMeanLongSun(float t) {
     float L0 = 280.46646 + t * (36000.76983 + t * 0.0003032);
     while (L0 > 360) {
       L0 -= 360;
     }
     while (L0 < 0) {
       L0 += 360;
     }
     return L0; // in degrees
   }


   float geomMeanAnomalySun(float t) {
     float M = 357.52911 + t * (35999.05029 - 0.0001537 * t);
     return M; // in degrees
   }


   /* --------------------------- UTILITY FUNCTIONS ---------------------------- */
   /* Convert Gregorian calendar date to Julian Day.
    */
   float jDay(int year, int month, int day) {
     if (month <= 2) {
       year  -= 1;
       month += 12;
     }

     int A = floor(year/100);
     int B = 2 - A + floor(A/4);
     return floor(365.25 * (year + 4716)) + floor(30.6001 * (month + 1)) +
            day + B - 1524.5;
   }


   /* Return fraction of time elapsed this century, AD 2000 2100.
    *
    * NOTE: 2,451,545 was the Julian day starting at noon UTC on 1 January AD 2000.
    *       36,525 is a Julian century.
    */
   float fractionOfCentury(float jd) {
     return (jd - 2451545) / 36525;
   }


   float radToDeg(float rad) {
     return 180 * rad / PI;
   }


   float degToRad(float deg) {
     return PI * deg / 180;
   }


   /*
     MoonPhase.cpp - Library to get moon phase angle
     and percentage illuminated. (as seen from Earth)
     Created by Marcel Timmer, April 28, 2018.
     Code adapted from http://www.voidware.com/phase.c
     A big thanks to Hugh at voidware for granting permission.
     Released under MIT license.
   */

   static double _Julian( int32_t year, int32_t month, const double &day )
   {
     int32_t b, c, e;
     b = 0;
     if (month < 3) {
       year--;
       month += 12;
     }
     if (year > 1582 || (year == 1582 && month > 10) ||
         (year == 1582 && month == 10 && day > 15)) {
       int32_t a;
       a = year / 100;
       b = 2 - a + a / 4;
     }
     c = 365.25 * year;
     e = 30.6001 * (month + 1);
     return b + c + e + day + 1720994.5;
   }

   static double _sun_position( const double &j )
   {
     double n, x, e, l, dl, v;
     int32_t i;
     n = 360 / 365.2422 * j;
     i = n / 360;
     n = n - i * 360.0;
     x = n - 3.762863;
     if (x < 0) x += 360;
     x *= DEG_TO_RAD;
     e = x;
     do {
       dl = e - .016718 * sin(e) - x;
       e = e - dl / (1 - .016718 * cos(e));
     } while (fabs(dl) >= 1e-12);
     v = 360 / PI * atan(1.01686011182 * tan(e / 2));
     l = v + 282.596403;
     i = l / 360;
     l = l - i * 360.0;
     return l;
   }

   static double _moon_position( const double &j, const double &ls )
   {
     double ms, l, mm, ev, sms, ae, ec;
     int32_t i;
     ms = 0.985647332099 * j - 3.762863;
     if (ms < 0) ms += 360.0;
     l = 13.176396 * j + 64.975464;
     i = l / 360;
     l = l - i * 360.0;
     if (l < 0) l += 360.0;
     mm = l - 0.1114041 * j - 349.383063;
     i = mm / 360;
     mm -= i * 360.0;
     ev = 1.2739 * sin((2 * (l - ls) - mm) * DEG_TO_RAD);
     sms = sin(ms * DEG_TO_RAD);
     ae = 0.1858 * sms;
     mm += ev - ae - 0.37 * sms;
     ec = 6.2886 * sin(mm * DEG_TO_RAD);
     l += ev + ec - ae + 0.214 * sin(2 * mm * DEG_TO_RAD);
     l = 0.6583 * sin(2 * (l - ls) * DEG_TO_RAD) + l;
     return l;
   }

   static moonData_t _getPhase( const int32_t &year, const int32_t &month, const int32_t &day, const double &hour )
   {
   /*
     Calculates the phase of the moon at the given epoch.
     returns the moon percentage that is lit as a real number (0-1)
   */
     double j = _Julian(year, month, (double)day + hour / 24.0) - 2444238.5;
     double ls = _sun_position(j);
     double lm = _moon_position(j, ls);
     double t = lm - ls;
     if (t < 0) t += 360;
     moonData_t returnValue;
     returnValue.angle = t;
     returnValue.percentLit = (1.0 - cos((lm - ls) * DEG_TO_RAD)) / 2;
     return returnValue;
   }

};

StarSunFieldWatchClassClass StarSunFieldWatchClassClassLoader;

// Put your functions here, outside of the class.
